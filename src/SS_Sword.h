
#include <PCM.h>
#include <Adafruit_MPU6050.h>
#include <Adafruit_Sensor.h>
#include <Wire.h>


Adafruit_MPU6050 mpu;


const unsigned char start[] PROGMEM = {
 126, 127, 127, 127, 128, 128, 127, 127, 128, 129, 127, 128,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 128, 
};

const unsigned char live[] PROGMEM = {
 126, 127, 127, 126, 126, 126, 126, 126, 127, 126, 126, 127,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 114, 
};

const unsigned char punch[] PROGMEM = {
 126, 126, 125, 127, 126, 126, 127, 126, 127, 127, 127, 127,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 129, 
};

class Sabia{
    private:

      byte led_r;  // Red pin
      byte led_g;  // Green Pin
      byte led_b;  // Blue  Pin
      byte pcm;    // Speaker
      byte button; // Button 


      bool sound = false;





    public:
    
      int r = 0;
      int g = 255;
      int b = 255;

      float x = 0;  // x acceleration
      float y = 0;  // y acceleration
      float z = 0;  // z accelartaion

      float move = 0; 
      float prevMove = 0;

     


      Sabia(byte r = 3, byte g = 5, byte b = 6, byte pcm = 11, byte button = 8){
          this->led_r = r;
          this->led_g = g;
          this->led_b = b;

          this->pcm = pcm;
          this->button = button;
      }


      void init(){ 

        Serial.begin(115200);
     	
     	mpu.begin();
      
        mpu.setAccelerometerRange(MPU6050_RANGE_8_G);
        mpu.setGyroRange(MPU6050_RANGE_500_DEG);
        mpu.setFilterBandwidth(MPU6050_BAND_21_HZ);

        pinMode(this->led_r, OUTPUT);
        pinMode(this->led_g, OUTPUT);
        pinMode(this->led_b, OUTPUT);

        digitalWrite(led_r, 255);
        digitalWrite(led_g, 255);
        digitalWrite(led_b, 255);

        delay(100);
    }

    void fade(int d = 0){  
      if(this->r != 255 && this->g == 0)   this->r++;
      if(this->r == 255 && this->g != 255 && this->b == 0) this->g++;
      if(this->r != 0 && this->g == 255 && this->b == 0)   this->r--;
      if(this->r == 0 && this->g == 255 && this->b != 255) this->b++;
      if(this->r == 0 && this->g != 0 && this->b == 255)   this->g--;
      if(this->r == 255 && this->g == 0 && this->b != 0)   this->b--;

      analogWrite(this->led_r, this->r);
      analogWrite(this->led_g, this->g);
      analogWrite(this->led_b, this->b);
      delay(d);
    }

    void setColor(int r, int g, int b){
      this->r = r;
      this->g = g;
      this->b = b;

      analogWrite(led_r, r);
      analogWrite(led_g, g);
      analogWrite(led_b, b);
    }

    /// Button functions 

    bool getButton(){
      return digitalRead(this->button);
    } 


    /// MPU6050 functions

    void moveUpdate(){
      sensors_event_t a, g, temp;
      mpu.getEvent(&a, &g, &temp);

      this->x = a.acceleration.x;
      this->y = a.acceleration.y;
      this->z = a.acceleration.z;

      this->move = (abs(x) + abs(y) + abs(z))/3;

      if(millis() % 100 == 0) this->prevMove = this->move; 

    }

    bool getMove(){
      return (abs(this->move - this->prevMove) >= 7.8); 
    }

    float getAcclerationX(){
      return this->x;
    }

    float getAcclerationY(){
     return this->y;
    }

    float getAcclerationZ(){
      return this->z;
    }

    float getGyroX(){
      sensors_event_t a, g, temp;
      mpu.getEvent(&a, &g, &temp);
      return g.gyro.x;
    }

    float getGyroY(){
      sensors_event_t a, g, temp;
      mpu.getEvent(&a, &g, &temp);
      return g.gyro.y;
    }

    float getGyroZ(){
      sensors_event_t a, g, temp;
      mpu.getEvent(&a, &g, &temp);
      return g.gyro.z;
    }


    /// Sound funstion

    void getStartSound(){
          startPlayback(start, sizeof(start));
          delay(800);
    }

    void getLiveSound(){
    	if(millis() % 700 == 0){
        	startPlayback(live, sizeof(live));
        }  
    }

    void getPunchSound(){
        startPlayback(punch, sizeof(punch));  
        delay(585);
    }


};
